#include <reg51.h>
#include <string.h> //后面字符串函数中取得数组的个数中用到;调用strlen函数
#define uchar unsigned char
#define uint unsigned int

uchar code tab1[]={"Hello, world!"}; //定义一个需要显示的数组
uchar code tab2[]={"Welcome!"};
uchar i;

//重新定义各个控制引脚的名称,  sbit 意思为<重定义>,,不要跟 bit 搞混,bit是汇编中 "位"

sbit lcdrs = P1^0;         //重定义,rs电平为1则传送数据,为0则转送指令
sbit lcdrw = P1^1;        //控制LCD读或者写;为1则读LCD,为0则写入LCD
sbit lcden = P1^2;        //LCD行动控制,EN为下降沿则交互执行,即EN = 1;跟着EN = 0;
  

//短暂延时函数
void delay_ms(uint z) 
{ 
  uchar x,y;
   for(x=z;x>0;x--)
    for(y=124;y>0;y--);
}

//********************************************读忙子程序*************
// 读忙字程序,用于判断LCD液晶是否忙状态.如果不进行判断可能会导致数据写入LCD失败.

void dbusy()                  //无返回值 函数名 (空)
{
     P0 = 0xff;                //把0xff发送给LCD的数据总线
     lcdrs = 0;               //选指令
     lcdrw = 1;               //选择读
     lcden = 1;               //使能端置1(高电平)
     while (P0 & 0x80);    //循环 (如果P0和0x80相等的话) P0 & 0x80相与,即P0总线的8位二进制数与10000000比较,
                               //全部相同则结果为 1<真>;忙状态成立,程序在此处死循环相与
     lcden = 0;               //使能端置0(低电平)
}
/**************************************************************************************/

/***********************************************写数据或指令子程序*******************/
void tcmddata (int x, unsigned char  DATA)//无返回值 函数名 (定义整形变量 x, 定义字符型变量 DATA)
{
   dbusy();
   delay_ms(50);              //读忙子程序
   P0 = DATA;      //如果不忙,则把参数 DDATA 获取到的变量赋值给 总线<P0>
   lcdrw = 0;      //读写端选择为 写<0>
   lcdrs = x;      //数据或指令端选择为参数 <x>的值, x的值为0或者1;为0表示总线传输的是控制LCD指令,为1表示要显示的数据
   lcden = 1;      //使能端置1
   lcden = 0;      //使能端置0; 接上一条指令形成一个下降沿,LCD识别到下降沿信号则读取总线内容
}
/**************************************************************************************/
//
/************************************************LCD初始化函数******************/
void lcd_init()            //无返回值 函数名 (空)，这里2004的初始化和1602的初始化指令完全相同 
{
   lcden=0;           //使能端EN清零，因为上电是默认高电平，所以先清零
     
   //显示模式设置
  tcmddata(0, 0x38);  //函数名 (指令, 指令内容)  //  0发送给tcmddata函数中的x,再经tcmddata函数发送给rs,即rs=0代表此时设置为命令方式;0x38为命令内容
                      //0x38  对1602设置16*2，对2004就代表16*4显示；5*7点阵；8位数据接口
   //显示开关及光标设置
  tcmddata(0, 0x08);  //0设置命令方式，0x08  表示只开显示
   //数据控制设置
  tcmddata(0, 0x06); //0设置命令方式，0x06  表示当写入一个字符的数据后，地址指针自动加1，且光标右移，字符不动

  tcmddata(0, 0x0c);  //0设置命令方式，0x0c  表示开显示，不显示光标
}
/*************************************************************************************/

 
/**********************定义显示位置*******************************************************************/
void set_xy(uchar x,uchar y)
{  
   switch(x)
   {
    case 1: y = y + 0x80;break;
	case 2: y = y + 0xc0;break;
	case 3: y = y + 0x94;break;
	case 4: y = y + 0xd4;break;
	default: y = y + 0x80;//
   }
   tcmddata(0,y);//0设置命令方式，规定显示起始的行列，x行，y列 

}

/**********************显示函数***********************************************************************/

void display(uchar x,uchar y,uchar *s)
{          
    set_xy(x,y); 
    while(*s)  	//对于一个不定长的字符串进行显示  
    {
     P0=*s;
	 tcmddata(1,*s);
	 s++;
    }
}

void main()
{
   lcd_init();//初始化
   
   while(1)
   {
    display(1,0,tab1);
	  display(2,0,tab2);
    display(3,0,"line helloooooo");
    display(4,0,"line helloooooo");
   }
}


